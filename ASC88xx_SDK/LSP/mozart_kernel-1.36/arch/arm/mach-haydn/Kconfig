## IPCAM_Reference/Application/mozart3s_Kilrogg_r47602_IPCam/apps/aenc/Kconfig
```kconfig
# This is a sample of video encoder Kconfig. 
# Here shows how to use "choice" in Kconfig. 

menu "Audio Setting"

config AUDIO_DEVICE_NUM
	int "Audio DEVICE Num"
	default 1

config AUDIO_TACK_NUM
	int "Audio Track Num"
	default 1

config G711
	bool "Enable G711 codec"
	default n

config G726
	bool "Enable G726 encoder"
	default n

config GAMR
	bool "Enable GAMR encoder"
	default n

config AAC4
	bool "Enable AAC4 encoder"
	default y

config SELECT_AUDIO_CODEC
	string "Selected audio default setting encoder:AAC4, G726, G711 ,GAMR"
	default "AAC4"
	depends on G711 || G726 || GAMR || AAC4

config  BIT_RATE
	int  "Default bit-rate setting"
	default 32000
	depends on G711 || G726 || GAMR || AAC4

config  SAMPLE_RATE
	int  "Sample rate setting"
	default 8000
	depends on G711 || G726 || GAMR || AAC4



config  AUDIO_ENC_MODE
	string "Selected G.711 audio encoding laws:alaw, ulaw"
	default "ulaw"
	depends on G711



endmenu






    
```

## IPCAM_Reference/Application/mozart3s_Kilrogg_r47602_IPCam/apps/onvif/Kconfig
```kconfig
# This is a sample of video encoder Kconfig. 
# Here shows how to use "choice" in Kconfig. 

menu "ONVIF Support"

config ONVIF
	bool "Enable ONVIF support"
	default n


endmenu
```

## IPCAM_Reference/Application/mozart3s_Kilrogg_r47602_IPCam/apps/psiad/Kconfig
```kconfig
# This is a sample of video encoder Kconfig. 
# Here shows how to use "choice" in Kconfig. 

menu "PSIA Support"

config PSIA
	bool "Enable the PSIA support"
	default n


endmenu
```

## IPCAM_Reference/Application/mozart3s_Kilrogg_r47602_IPCam/apps/venc/Kconfig
```kconfig
# This is a sample of video encoder Kconfig. 
# Here shows how to use "choice" in Kconfig. 

menu "Video Processing"

config AE
	bool "Enable the AE function of len"
	default n

config AWB
	bool "Enable the AWB function of len"
	default n 

config  DPC
        depends on MN34030PL
        bool "Enable Defect Pixel Correction(For MN34031 Parallel)"
        default n
#config YUV422
#		bool "Set the input as YUV422 (default:YUV420)"
#        default n

config ENC_RESOLUTION
	string  "Encoding resolution"
	default "640x480"

menu "Support Text overlay"
config TEXT_OVERLAY
	bool "Enable the Text Overlay"
	default n
config CHINESE
	bool "Support Chinese Characters(Unicode)"
	default n
	depends on TEXT_OVERLAY
endmenu

config IRE
	bool "Support Resize Module"
	default y

config IBP
	bool "Support Image Backend Processing"
	default n
config DIE
	bool "Support DeInterlace"
	default n
	depends on IBP

config PRE_NR
	bool "Support Pre-NR"
	default n
	depends on IBP

config AUTOSCENE
	bool "Enable AutoScene"
	default n

config 1DRAM_VERSION
	bool "Enable only one DRAM"
	default n
	help 
	  Say Y here if you wish to support only one DRAM version. This will allocate all memory at DRAM 0.
	  Most case should answer N.

#config UART_IRCUT
#        bool "Support IRCUT control"
#	default n

config MAXVIDEOSTREAMNUM
	int "MAX Video Stream Num"
	default 4

config MAXVIDEOCHANNELNUM
	int "MAX Video Channel Num"
	default 1

config BAYERPATTERNBITWIDTH
	int "Bayer Pattern Bitwidth"
	default 12

#config AWBAFTERCCENABLE
#	int "AWB after CC enable"
#	default 0

menu "H264"
config H264
	bool "Support H264 encoder"
	default n
config H264_KEY_INTERVAL
	int  "H264 key interval"
	default 30
	depends on H264
config H264_QUALITY_TYPE
	string "H264 quality type:NONE, VQCB, CQCB, CVBR, ADPT"
	default "NONE"
	depends on H264
config H264_QUAT_VALUE
	int  "H264 quant value"
	default 25
	depends on H264 
	
config H264_MIN_QUAT_VALUE
	int  "H264 MIN quant value"
	default 0
	depends on H264 
	
config H264_MAX_QUAT_VALUE
	int  "H264 MAX quant value"
	default 51
	depends on H264 	

	
config H264_MIN_FRAMERATE
	int  "H264 MIN frame rate"
	default 0
	depends on H264

config H264_MAX_FRAMERATE
	int  "H264 MAX frame rate"
	default 60
	depends on H264

config H264_MAX_SEARCHRANGE_X
	int  "H264 Search Range X"
	default 2
	depends on H264

config H264_MAX_SEARCHRANGE_Y
	int  "H264 Search Range Y"
	default 2
	depends on H264	
	
config H264_REF_FRAME_NUM
	int  "H264 Reference Frame Num"
	default 1
	depends on H264	
	
	
config H264_BITRATE
	int "H264 bitrate"
	default 384000
	depends on H264


config ROI_ENABLE
	string "Enable ROI encoding"
	default "off"
	depends on H264
	
#config MD_TRIGER_ROI
#	bool "Motions triger ROI"
#	default n
#	depends on IBP && H264

endmenu

menu "SVC-T"
config SVC
	bool "Support SVC-T encoder"
	default n
config SVC_KEY_INTERVAL
	int  "SVC-T key interval"
	default 30
	depends on SVC
config SVC_QUALITY_TYPE
	string "SVC-T quality type:NONE, VQCB, CQCB, CVBR"
	default "CVBR"
	depends on SVC
config SVC_QUAT_VALUE
	int  "SVC-T quant value"
	default 25
	depends on SVC 
config SVC_BITRATE
	int "SVC-T bitrate"
	default 4000000
	depends on SVC
config SVC_HDR_ENABLE
	string "SVC-T header enable (on/off)"
	default  "on"
	depends on SVC 
config SVC_MAX_LAYER_NUM
	int "SVC-T MAX layer number"
	default 4
	depends on SVC

config ROI_ENABLE
	string "Enable ROI encoding"
	default "off"
	depends on SVC
 
endmenu

#menu "ROI"
#config ENC_ROI
#      bool "Support ROI encoding of H.264"
#      default n
#      depends on H264 || SVC
#config ROI_ENABLE
#       string "Default enable ROI encoding of H.264"
#       default "off"
#       depends on  ENC_ROI
#config ROI_DELTAQ
#       int "Default Delta of Q value of H.264"
#       default -15
#       depends on  ENC_ROI
#endmenu


menu "MJPEG"
config JPEG
	bool "Support JPEG encoder"
	default n
config JPEG_QUAT_VALUE
	int  "MJPEG quant value"
	default 50
	depends on JPEG
config JPEG_SNAPSHOT
	bool "JPEG snapshot"
	default y
	depends on JPEG
endmenu

menu "MPV4"
config MPV4
	bool "Support MPEG4 encoder"
	default n
config MPV4_KEY_INTERVAL
	int  "MPV4 key interval"
	default 30
	depends on MPV4
config MPV4_QUALITY_TYPE
	string "MPV4 quality type:NONE, VQCB, CQCB, CVBR"
	default "NONE"
	depends on MPV4
config MPV4_QUAT_VALUE
	int  "MPV4 quant value"
	default 7
	depends on MPV4 
config MPV4_BITRATE
	int "MPV4 bitrate"
	default 384000
	depends on MPV4
endmenu




endmenu
```

## IPCAM_Reference/Application/mozart3s_Kilrogg_r47602_IPCam/apps/vrec/Kconfig
```kconfig
# This is a sample of video encoder Kconfig. 
# Here shows how to use "choice" in Kconfig. 

menu "Video Recorder"

config RECORD
	bool "Enable the video recording"
	default n

config RECORDSTREAMNUM
	int "Record Stream Num (begin from 1)"
	default 4
endmenu
```

## IPCAM_Reference/Application/mozart3s_Kilrogg_r47602_IPCam/drivers/Kconfig
```kconfig
# This is a sample of video encoder Kconfig. 
# Here shows how to use "choice" in Kconfig. 

menu "Device Driver"

choice
	prompt "Audio Codec"
	default NONEAUDIO
	help
	  Choose with which audio codec you would like to build. 
config SSM2603
	bool "SSM2603 audio codec"
config TW2866_AUDIO
	bool "TW2866 audio codec"
config NVP1114A_AUDIO
	bool "NVP1114A audio codec"
config WAU8822
	bool "WAU8822 audio codec"
config WM8978
	bool "WM8978 audio codec"
config CAT6011_HDMI_AUDIO
	bool "HDMI aduio (for CAT6011)"
config IT6604_HDMI_AUDIO
	bool "HDMI aduio (for IT6604)"
config NONEAUDIO
	bool "No audio codec on the board"

endchoice

choice
	prompt "VOC Clock Source"
	default OSC_SRC
	depends on VOC
	help
	  Choose with which clock source of VOC you would like to build. 
	config XTAL_SRC
	  bool "Crystal Clock Source"
	config OSC_SRC 
	  bool "External Oscillator Clock Source"
endchoice

menu "Wifi Drivers"

choice
	prompt "USB Wifi Device Support"
	default USB_NONE
	help
	  Choose which USB Wifi Adapter support you would like to build. 
	config USB_WIFI_DWA125
	  bool "Dlink USB Wifi Adapter DWA-125 (N150)"
	config USB_WIFI_NW362 
	  bool "Net-Core USB Wifi Adapter NW362 (300M)"
	config USB_WIFI_RT3070 
		bool "RT3070 USB Wifi Adapter (150M)"
	config USB_NONE
	  bool "None"
endchoice

choice
	prompt "PCIe Wifi Device Support"
	default PCIE_NONE
	help
	  Choose which PCIe Wifi Adapter support you would like to build. 
	config PCIE_WIFI_ATHEROS 
	  bool "Atheros PCIe Wifi Adapter WPEA-110N/E[AR6BXB92]"
	  help
	    Note: Make CONFIG_CFG80211=m & CONFIG_MAC80211=m at linux kernel and recompile the kernel source.
	config PCIE_NONE
	  bool "None"
endchoice

comment "For Atheros PCIe Card. Make sure kernel compiled with option CONFIG_CFG80211=m & CONFIG_MAC80211=m"

endmenu

#config MEDIAMEMSIZE
#	int "Memory Size allocation for Media Engines(VML)"
#	default 192

config MMC
	bool "MMC/SDHC controller driver(vpl_mmc.ko)"
	default y

config OTG 
	bool "USB OTG controller driver(dwc_otg.ko)"
	default y

config IRRC
	bool "IRDA controller driver(irrc.ko)"
	default y
config TMRC
	bool "Timer controller(vpl_tmrc.ko)"
	default y
config WDT
	bool "Watch Dog Timer driver(wdt.ko)"
	default y
config DCE
	bool "Data crypto engine driver(vma_dce.ko)"
	default y
config I2C_GPIO
	bool "I2C_GPIO driver(i2c-gpio.ko)"
	default y
config IRCUTCONTROLMODE
	bool "IR-Cut control mode(ircut.ko)"
	default y

config DISABLE_KERNEL_MSG
	bool "Disable the installation message of drivers"
	default n
endmenu
```

## IPCAM_Reference/Application/mozart3s_Kilrogg_r47602_IPCam/opensrc/Kconfig
```kconfig
# This is a sample of video encoder Kconfig. 
# Here shows how to use "choice" in Kconfig. 

menu "Opensource application selection"

config APPS_LIGHTTPD
	bool "lighttpd"
	default y

config APPS_LUA
	bool "LUA"
	default n

config APPS_DDNS
	bool "ddns"
	default n


config APPS_SYSKLOGD
	bool "sysklogd"
	default n

config APPS_PPP
	bool "ppp"
	default n

config APPS_MDNSRESPONDER
	bool "mDNSResponder"
	default n

config APPS_MSNTP
	bool "msntp"
	default n

config APPS_OPENSSL 
	bool "openssl"
	default n

config APPS_STUNNEL 
	bool "stunnel"
	default n

config APPS_LIVE555_RTSPS
	bool "Live555 RTSP Server"
	default n

config APPS_DHCP_SERVER
	bool "DHCP Server"
	default n
        help 
          Enable DHCP server in case wifi support was enabled. 


endmenu
```
